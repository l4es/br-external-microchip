## package/flir-lepton-sdk-at91/Config.in
```kconfig
config BR2_PACKAGE_FLIR_LEPTON_SDK_AT91
	bool "flir-lepton-sdk-at91"
	help
	  This is the FLIR lepton SDK for Microchip A91 based platforms.
	  https://github.com/l4es/flir-lepton-sdk-at91

if BR2_PACKAGE_FLIR_LEPTON_SDK_AT91
choice
prompt "Build Configuration"

config BR2_PACKAGE_FLIR_LEPTON_SDK_AT91_CONF_DEBUG
        bool "Debug Build"
        default y

config BR2_PACKAGE_FLIR_LEPTON_SDK_AT91_CONF_RELEASE
        bool "Release Build"
endchoice

config BR2_PACKAGE_FLIR_LEPTON_SDK_AT91_CONF
        string
        default "Debug" if BR2_PACKAGE_FLIR_LEPTON_SDK_AT91_CONF_DEBUG
        default "Release" if BR2_PACKAGE_FLIR_LEPTON_SDK_AT91_CONF_RELEASE
endif
```

## package/flir-lepton-tools/Config.in
```kconfig
menu "Toolset for FLIR Lepton thermal sensors"

source "$BR2_EXTERNAL_MCHP_PATH/package/flir-lepton-tools/lepton-spidev-capture/Config.in"
source "$BR2_EXTERNAL_MCHP_PATH/package/flir-lepton-tools/lepton-v4l2-capture/Config.in"
source "$BR2_EXTERNAL_MCHP_PATH/package/flir-lepton-tools/lepton-v4l2-stream/Config.in"

endmenu
```

## package/flir-lepton-tools/lepton-spidev-capture/Config.in
```kconfig
config BR2_PACKAGE_LEPTON_SPIDEV_CAPTURE
    bool "lepton-spidev-capture"
    help
        Capture thermal image from FLIR Lepton sensor via /dev/spidevX.Y
```

## package/flir-lepton-tools/lepton-v4l2-capture/Config.in
```kconfig
config BR2_PACKAGE_LEPTON_V4L2_CAPTURE
    bool "lepton-v4l2-capture"
    depends on BR2_PACKAGE_V4L2LOOPBACK
    depends on BR2_PACKAGE_FLIR_LEPTON_SDK_AT91
    help
        Capture thermal image from FLIR Lepton sensor via /dev/videoX
```

## package/flir-lepton-tools/lepton-v4l2-stream/Config.in
```kconfig
config BR2_PACKAGE_LEPTON_V4L2_STREAM
    bool "lepton-v4l2-stream"
    depends on BR2_PACKAGE_LEPTON_V4L2_CAPTURE
    depends on BR2_PACKAGE_LIBGLIB2
    depends on BR2_PACKAGE_BOOST_SYSTEM
    depends on BR2_PACKAGE_GSTREAMER1
    depends on BR2_PACKAGE_WEBSOCKETPP
    help
        Stream FLIR Lepton as V4L2 camera to client.
```

## package/v4l2-stream/Config.in
```kconfig
config BR2_PACKAGE_V4L2_STREAM
    bool "v4l2-stream"
    depends on BR2_PACKAGE_LIBGLIB2
    depends on BR2_PACKAGE_BOOST_SYSTEM
    depends on BR2_PACKAGE_GSTREAMER1
    depends on BR2_PACKAGE_WEBSOCKETPP
    help
        Stream V4L2 camera to client.
```
